## drivers/clk/imx/Kconfig
```kconfig
# SPDX-License-Identifier: GPL-2.0
# common clock support for NXP i.MX SoC family.
config MXC_CLK
	bool
	depends on ARCH_MXC

config MXC_CLK_SCU
	bool
	depends on ARCH_MXC && ARM64
```

## sound/soc/sof/imx/Kconfig
```kconfig
config SND_SOC_SOF_IMX_TOPLEVEL
	bool "SOF support for NXP i.MX audio DSPs"
	help
          This adds support for Sound Open Firmware for NXP i.MX platforms.
          Say Y if you have such a device.
          If unsure select "N".

config SND_SOC_SOF_IMX8
	tristate "SOF support for i.MX8"
	#select SND_SOC_SOF_DT
	help
          This adds support for Sound Open Firmware for i.MX8 platforms
          Say Y if you have such a device.
          If unsure select "N".
```
